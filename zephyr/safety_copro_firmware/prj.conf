## CMakeLists.txt
```
# CMakeLists.txt - Real-Time Safety Co-Processor Supervisor firmware
#
# 標準 Zephyr application 結構。Board target: qemu_cortex_a53/qemu_cortex_a53/smp
#
# 建置範例：
#   FORMAL: west build -b qemu_cortex_a53/qemu_cortex_a53/smp .
#   DEBUG : west build -b qemu_cortex_a53/qemu_cortex_a53/smp . -- \
#               -DOVERLAY_CONFIG=prj_debug.conf
#   或直接指定 CONF_FILE=prj_debug.conf 取代 prj.conf。

cmake_minimum_required(VERSION 3.20.0)

find_package(Zephyr REQUIRED HINTS $ENV{ZEPHYR_BASE})
project(safety_copro_firmware C)

target_sources(app PRIVATE
	src/main.c
	src/heartbeat_task.c
	src/telemetry_task.c
	src/fault_monitor_task.c
	src/command_handler_task.c
	src/safety_protocol.c
)

# include/ 內含 LOCKED 的 safety_protocol.h 與 firmware 內部 safety_app.h
target_include_directories(app PRIVATE include)
```

## prj.conf
```kconfig
# prj.conf - FORMAL build：single binary protocol UART only.

CONFIG_MULTITHREADING=y
CONFIG_SMP=y
CONFIG_MP_MAX_NUM_CPUS=2
CONFIG_SCHED_CPU_MASK=y

CONFIG_SERIAL=y
CONFIG_UART_INTERRUPT_DRIVEN=y

# Formal binary UART must stay free of console/log/shell text.
CONFIG_CONSOLE=n
CONFIG_UART_CONSOLE=n
CONFIG_LOG=n
CONFIG_PRINTK=n
CONFIG_SHELL=n

# Unused subsystems stay off in the formal build.
CONFIG_BT=n
CONFIG_NETWORKING=n
CONFIG_WIFI=n
CONFIG_FILE_SYSTEM=n
CONFIG_SENSOR=n
CONFIG_SETTINGS=n
CONFIG_MBEDTLS=n
CONFIG_NEWLIB_LIBC=n

CONFIG_MAIN_STACK_SIZE=2048
CONFIG_SYSTEM_WORKQUEUE_STACK_SIZE=2048
CONFIG_IDLE_STACK_SIZE=1024

CONFIG_HEAP_MEM_POOL_SIZE=0
CONFIG_BOOT_BANNER=n
```

## prj_debug.conf
```kconfig
# prj_debug.conf - DEBUG build (人工故障注入用)
#
# 用法 (擇一)：
#   west build -b qemu_cortex_a53/qemu_cortex_a53/smp . -- \
#       -DOVERLAY_CONFIG=prj_debug.conf
#   或設 CONF_FILE 取代 prj.conf。
#
# 本檔在 FORMAL (prj.conf) 基礎上加開 Zephyr shell/logging，僅供手動觀察。
#
# !!! 注意 (debug-only) !!!
#   shell 與二進位協定共用同一條 console UART (PL011)。開啟 shell 後，shell 的
#   文字輸出會與協定 frame 交錯，因此「正式 host 協定 demo 不可用此 build」。
#   DEBUG build 僅供工程師在終端機手動敲指令觸發/清除故障旗標。

CONFIG_SMP=y
CONFIG_MP_MAX_NUM_CPUS=2
CONFIG_SCHED_CPU_MASK=y

CONFIG_SERIAL=y
CONFIG_UART_INTERRUPT_DRIVEN=y
CONFIG_CONSOLE=y
CONFIG_UART_CONSOLE=y
CONFIG_PRINTK=y
CONFIG_LOG=y

CONFIG_MAIN_STACK_SIZE=2048
CONFIG_SYSTEM_WORKQUEUE_STACK_SIZE=2048
CONFIG_IDLE_STACK_SIZE=1024
CONFIG_HEAP_MEM_POOL_SIZE=4096
CONFIG_BOOT_BANNER=y

# ---- DEBUG 差異：開啟 shell ----
CONFIG_SHELL=y
CONFIG_SHELL_BACKEND_SERIAL=y
# shell backend thread 需要足夠 stack 處理 safety status 多行輸出
CONFIG_SHELL_STACK_SIZE=2048

# 方便除錯：開 thread 名稱與 runtime stats / kernel shell
CONFIG_THREAD_NAME=y
CONFIG_THREAD_MONITOR=y
CONFIG_KERNEL_SHELL=y
```

## src/main.c
```c
/*
 * main.c - Safety Co-Processor Firmware 進入點與執行緒/CPU 配置
 *
 * 角色：
 *   1. 初始化共享故障狀態 g_fault_state。
 *   2. 初始化 UART 二進位協定通道 (safety_protocol.c)。
 *   3. 以 K_THREAD_STACK_DEFINE + k_thread_create 建立四個 task，
 *      並在「啟動前」用 k_thread_cpu_mask_* 把 heartbeat/telemetry 釘到
 *      固定 CPU，再 k_thread_start。
 *
 * SMP / CPU pin 理由 (qemu_cortex_a53/smp, 2 CPUs)：
 *   - heartbeat 釘 CPU0：心跳是最關鍵的存活訊號，必須節奏穩定。
 *   - telemetry 釘 CPU1：與心跳分屬不同 CPU，避免一般遙測工作搶占心跳時間片。
 *   - fault monitor / command handler 不釘：由 scheduler 在
 *     兩顆 CPU 間自由負載平衡。
 *
 * Zephyr API 重點：
 *   - k_thread_cpu_mask_clear / k_thread_cpu_mask_enable 只能在 thread 處於
 *     「尚未啟動 (created suspended) 或已 suspended/blocked」時呼叫。
 *     因此用 K_FOREVER 延遲建立 (= 建立但不排程)，設好 mask 後再 k_thread_start。
 *   - 需要 CONFIG_SMP=y + CONFIG_SCHED_CPU_MASK=y。
 */

#include <zephyr/kernel.h>

#include "safety_app.h"
#include "safety_protocol.h"

/* ===================================================================
 *  共享故障狀態 (全域單例；extern 宣告於 safety_app.h)
 * =================================================================== */
struct safety_fault_state g_fault_state;

/* ===================================================================
 *  Thread stacks 與 control blocks
 * =================================================================== */
K_THREAD_STACK_DEFINE(heartbeat_stack, SAFETY_STACK_HEARTBEAT);
K_THREAD_STACK_DEFINE(telemetry_stack, SAFETY_STACK_TELEMETRY);
K_THREAD_STACK_DEFINE(fault_stack, SAFETY_STACK_FAULT);
K_THREAD_STACK_DEFINE(command_stack, SAFETY_STACK_COMMAND);

static struct k_thread heartbeat_thread;
static struct k_thread telemetry_thread;
static struct k_thread fault_thread;
static struct k_thread command_thread;

/*
 * 建立一個「延遲啟動 (K_FOREVER)」的 thread。
 * 若 cpu >= 0 則先清空 CPU mask 再只 enable 該 CPU (= pin)；最後 start。
 * cpu < 0 表示不 pin，交給 scheduler。
 */
static void spawn_pinned(struct k_thread *thr, k_thread_stack_t *stack,
			 size_t stack_size, k_thread_entry_t entry,
			 int prio, int cpu, const char *name)
{
	k_tid_t tid;

	/* K_FOREVER：建立但不排程，讓我們能在啟動前安全設定 CPU mask。 */
	tid = k_thread_create(thr, stack, stack_size, entry,
			      NULL, NULL, NULL, prio, 0, K_FOREVER);

	(void)k_thread_name_set(tid, name);

#if defined(CONFIG_SCHED_CPU_MASK)
	if (cpu >= 0) {
		/* 先全清，再只開放目標 CPU = 釘死在該 CPU。 */
		(void)k_thread_cpu_mask_clear(tid);
		(void)k_thread_cpu_mask_enable(tid, cpu);
	}
#else
	ARG_UNUSED(cpu);
#endif

	k_thread_start(tid);
}

int main(void)
{
	/* 1) 初始化共享狀態 */
	safety_state_init(&g_fault_state);

	/* 2) 初始化 UART 協定通道 */
	if (safety_uart_init() != 0) {
		return -1;
	}

	/* 3) 建立並 (必要時) 釘住各 task */
	spawn_pinned(&heartbeat_thread, heartbeat_stack,
		     K_THREAD_STACK_SIZEOF(heartbeat_stack),
		     heartbeat_task_entry, SAFETY_PRIO_HEARTBEAT,
		     SAFETY_CPU_HEARTBEAT, "heartbeat");

	spawn_pinned(&telemetry_thread, telemetry_stack,
		     K_THREAD_STACK_SIZEOF(telemetry_stack),
		     telemetry_task_entry, SAFETY_PRIO_TELEMETRY,
		     SAFETY_CPU_TELEMETRY, "telemetry");

	spawn_pinned(&command_thread, command_stack,
		     K_THREAD_STACK_SIZEOF(command_stack),
		     command_handler_task_entry, SAFETY_PRIO_COMMAND,
		     -1, "command");

	spawn_pinned(&fault_thread, fault_stack,
		     K_THREAD_STACK_SIZEOF(fault_stack),
		     fault_monitor_task_entry, SAFETY_PRIO_FAULT,
		     -1, "fault_monitor");

	/* main thread 任務完成；回傳即結束 main (其它 task 繼續執行)。 */
	return 0;
}
```

## include/safety_app.h
```c
/*
 * safety_app.h - Safety Co-Processor Firmware 內部共用標頭
 *
 * 角色：定義「整個 firmware 共用」的東西——
 *   - 共享故障狀態 (fault state) 結構與其 atomic 欄位
 *   - thread 優先權、stack 大小、CPU pin 巨集
 *   - 各 task entry point 與 frame TX / RX 輔助函式原型
 *   - UART 裝置取得方式
 *
 * 本檔不負責線格式 (那是 safety_protocol.h，LOCKED 不可改)，
 * 只負責 firmware 端的執行緒/狀態/IO 抽象。
 *
 * CPU pin 概念 (qemu_cortex_a53/smp, 2 CPUs)：
 *   - CPU0：heartbeat task (心跳必須最即時，與遙測負載隔離)
 *   - CPU1：telemetry task (高頻送資料，可能爆量，不可拖累心跳)
 *   - 其餘 (fault monitor / command handler / main) 不 pin，
 *     由 scheduler 在兩顆 CPU 間自由調度。
 */

#ifndef SAFETY_APP_H
#define SAFETY_APP_H

#include <zephyr/kernel.h>
#include <zephyr/device.h>
#include <zephyr/sys/atomic.h>
#include "safety_protocol.h"

#ifdef __cplusplus
extern "C" {
#endif

/* ===================================================================
 *  Thread 優先權 (數字越小越優先；皆為 preemptible 正優先權)
 * =================================================================== */
#define SAFETY_PRIO_HEARTBEAT   4   /* 最高：心跳最即時 */
#define SAFETY_PRIO_COMMAND     5   /* 命令處理 */
#define SAFETY_PRIO_FAULT       6   /* 故障監測 */
#define SAFETY_PRIO_TELEMETRY   7   /* 最低：遙測可被搶占 */

/* ===================================================================
 *  Thread stack 大小 (對應 prj.conf 內各自的 Kconfig 註解)
 * =================================================================== */
#define SAFETY_STACK_HEARTBEAT  1024
#define SAFETY_STACK_TELEMETRY  1536
#define SAFETY_STACK_FAULT      1536
#define SAFETY_STACK_COMMAND    2048

/* ===================================================================
 *  CPU pin (需要 CONFIG_SMP=y + CONFIG_SCHED_CPU_MASK=y)
 * =================================================================== */
#define SAFETY_CPU_HEARTBEAT    0
#define SAFETY_CPU_TELEMETRY    1

/* ===================================================================
 *  時序預設值
 * =================================================================== */
#define SAFETY_DEFAULT_HEARTBEAT_MS   100u   /* 心跳預設 100ms */
#define SAFETY_TELEMETRY_PERIOD_MS    250u   /* 遙測 250ms */
#define SAFETY_FAULT_SCAN_MS          100u   /* 故障掃描 100ms */

/* ===================================================================
 *  共享故障狀態
 *  ----------------------------------------------------------------
 *  注入旗標 (inject_*) 與計數使用 atomic_t，可在任意 task / shell /
 *  UART ISR-thread context 無鎖讀寫。heartbeat_interval_ms 也以 atomic
 *  存放 (單一 32-bit 寫入在 ARM64 為 atomic，但仍用 atomic API 表明意圖)。
 * =================================================================== */
struct safety_fault_state {
	atomic_t inject_task_hang;        /* 1 = heartbeat_stop，不送 HEARTBEAT */
	atomic_t inject_checksum_error;   /* 1 = 回報 checksum_error_response */
	atomic_t inject_critical_fault;   /* 1 = 回報 critical FAULT_EVENT */
	atomic_t fault_count;             /* 已偵測/回報的故障總數 */
	atomic_t in_safe_mode;            /* 1 = safe mode，週期性送資料暫停 */
	atomic_t heartbeat_interval_ms;   /* 心跳週期 (ms)，預設 100 */
};

/* 全域單例 (定義於 main.c) */
extern struct safety_fault_state g_fault_state;

/* ---- 故障狀態存取輔助 (inline) ---- */
static inline void safety_state_init(struct safety_fault_state *s)
{
	atomic_clear(&s->inject_task_hang);
	atomic_clear(&s->inject_checksum_error);
	atomic_clear(&s->inject_critical_fault);
	atomic_clear(&s->fault_count);
	atomic_clear(&s->in_safe_mode);
	atomic_set(&s->heartbeat_interval_ms, SAFETY_DEFAULT_HEARTBEAT_MS);
}

/* ===================================================================
 *  RX：解析完成的 frame 透過 message queue 交給 command handler
 *  ----------------------------------------------------------------
 *  一筆訊息 = 一個完整且已驗證 (checksum OK) 的 frame，封裝成定長結構，
 *  避免在 queue 內傳指標 / 動態配置。
 * =================================================================== */
struct safety_rx_frame {
	struct SafetyFrameHeader hdr;
	safety_u8 payload[SAFETY_MAX_PAYLOAD];
};

extern struct k_msgq g_rx_msgq;   /* 定義於 safety_protocol.c */

/* ===================================================================
 *  函式原型
 * =================================================================== */

/* --- safety_protocol.c：firmware 端 IO / 時間輔助 --- */

/* 取得單調 uptime (ms)，截成 32-bit 給線格式用。 */
uint32_t safety_now_ms(void);

/* 初始化 UART（取得裝置、設定 IRQ callback、啟用 RX 中斷）。
 * 回傳 0 成功，負值失敗。 */
int safety_uart_init(void);

/*
 * Frame TX helper：把指定 type + payload 封裝成完整 frame 並整包送出 UART。
 * sequence_id 由內部單調遞增 (thread-safe)。payload 可為 NULL（payload_len=0）。
 * 回傳送出的位元組數，失敗回傳負值。
 * TX 受一把 mutex 保護，確保多 task 不會交錯位元組。
 */
int safety_send_frame(safety_u8 type, const void *payload,
		      safety_u16 payload_len);

/* 取得目前已送出的 frame 數 (除錯用)。 */
uint32_t safety_tx_seq_peek(void);

/* --- 各 task entry point --- */
void heartbeat_task_entry(void *p1, void *p2, void *p3);
void telemetry_task_entry(void *p1, void *p2, void *p3);
void fault_monitor_task_entry(void *p1, void *p2, void *p3);
void command_handler_task_entry(void *p1, void *p2, void *p3);

#ifdef __cplusplus
}
#endif

#endif /* SAFETY_APP_H */
```

## include/safety_protocol.h
```c
/*
 * safety_protocol.h - Real-Time Safety Co-Processor Supervisor 共用通訊協定
 *
 * 這是整個專案的「單一事實來源 (single source of truth)」。
 * Linux kernel driver (C)、Zephyr firmware (C)、C++ userspace 三端共用「位元組
 * 完全一致」的線格式 (wire format)。本檔案會被同步複製到三個 consumer 位置：
 *
 *   - include/safety_protocol.h                    (此檔，canonical 來源)
 *   - userspace/common/safety_protocol.h           (C++ userspace/bridge copy)
 *   - linux/drivers/safety_copro/safety_protocol.h (kernel 內建 driver)
 *   - zephyr/safety_copro_firmware/include/...      (Zephyr firmware)
 *
 * consumer copy 必須與此檔 byte-identical；scripts/05_build_userspace.sh 會做一致性檢查。
 *
 * 設計重點：
 *   1. 整數寬度型別抽象 (safety_u8/16/32)，讓同一份 header 可在 kernel space、
 *      Zephyr、C++17 三種環境「不修改」直接編譯（kernel 無 <stdint.h>）。
 *   2. 線格式固定 little-endian。本專案三端 (x86_64 host、ARM64 Linux guest、
 *      ARM64 Zephyr) 皆為 little-endian，因此線上不做 byte swap，僅在文件中註明。
 *   3. checksum 使用標準 CRC-32 (IEEE 802.3, reflected, poly 0xEDB88320)，
 *      與 zlib / Python binascii.crc32 完全相容，方便跨語言驗證 (tests/)。
 */

#ifndef SAFETY_PROTOCOL_H
#define SAFETY_PROTOCOL_H

/* ---- 整數型別抽象：核心空間沒有 <stdint.h> ---- */
#if defined(__KERNEL__)
#  include <linux/types.h>
#  include <linux/string.h>          /* memcpy / memset */
typedef u8  safety_u8;
typedef u16 safety_u16;
typedef u32 safety_u32;
#else
#  include <stdint.h>
#  include <stddef.h>
#  include <string.h>
typedef uint8_t  safety_u8;
typedef uint16_t safety_u16;
typedef uint32_t safety_u32;
#endif

#ifdef __cplusplus
extern "C" {
#endif

/* ---- 協定常數 ---- */
#define SAFETY_PROTO_MAGIC        0x5346u   /* 'S','F' little-endian */
#define SAFETY_PROTO_VERSION      0x01u
#define SAFETY_MAX_PAYLOAD        256u
#define SAFETY_HEADER_SIZE        16u       /* sizeof(SafetyFrameHeader) */
#define SAFETY_MAX_FRAME_SIZE     (SAFETY_HEADER_SIZE + SAFETY_MAX_PAYLOAD)

/* ---- Frame 型別 (header.type) ---- */
enum safety_frame_type {
    SAFETY_FRAME_HEARTBEAT       = 0x01,
    SAFETY_FRAME_TELEMETRY       = 0x02,
    SAFETY_FRAME_FAULT_EVENT     = 0x03,
    SAFETY_FRAME_COMMAND         = 0x04,
    SAFETY_FRAME_ACK             = 0x05,
    SAFETY_FRAME_NACK            = 0x06,
    SAFETY_FRAME_RECOVERY_REPORT = 0x07,
};

/* ---- Command 型別 (CommandPayload.command) ---- */
enum safety_command_type {
    SAFETY_CMD_GET_STATUS            = 0x01,
    SAFETY_CMD_INJECT_FAULT          = 0x02,
    SAFETY_CMD_REQUEST_RECOVERY      = 0x03,
    SAFETY_CMD_ENTER_SAFE_MODE       = 0x04,
    SAFETY_CMD_RESET_FAULT_STATE     = 0x05,
};

/* ---- Fault 型別 (INJECT_FAULT 與 FAULT_EVENT 共用) ---- */
enum safety_fault_type {
    SAFETY_FAULT_NONE            = 0x00,
    SAFETY_FAULT_TASK_HANG       = 0x01,  /* heartbeat_stop */
    SAFETY_FAULT_CHECKSUM_ERROR  = 0x02,  /* checksum_error_response */
    SAFETY_FAULT_CRITICAL        = 0x03,
};

/* ---- NACK 原因碼 ---- */
enum safety_nack_reason {
    SAFETY_NACK_CHECKSUM     = 0x01,
    SAFETY_NACK_VERSION      = 0x02,
    SAFETY_NACK_SEQUENCE     = 0x03,
    SAFETY_NACK_UNKNOWN_TYPE = 0x04,
    SAFETY_NACK_PAYLOAD      = 0x05,
};

/* ---- Frame Header：固定 16 bytes，packed ---- */
#if defined(__GNUC__)
#  define SAFETY_PACKED __attribute__((packed))
#else
#  define SAFETY_PACKED
#endif

struct SAFETY_PACKED SafetyFrameHeader {
    safety_u16 magic;          /* SAFETY_PROTO_MAGIC */
    safety_u8  version;        /* SAFETY_PROTO_VERSION */
    safety_u8  type;           /* enum safety_frame_type */
    safety_u16 sequence_id;    /* 單調遞增序號，用於 ACK/NACK/duplicate 偵測 */
    safety_u16 payload_length; /* payload bytes，<= SAFETY_MAX_PAYLOAD */
    safety_u32 timestamp_ms;   /* 送出端 uptime (ms) */
    safety_u32 checksum;       /* CRC-32 over (header[checksum=0] ++ payload) */
};

/* ---- Payload 結構（皆為固定大小，packed）---- */
struct SAFETY_PACKED SafetyHeartbeatPayload {
    safety_u32 uptime_ms;
    safety_u32 beat_seq;
};

struct SAFETY_PACKED SafetyTelemetryPayload {
    safety_u16 temperature_c_x10; /* 攝氏溫度 x10，例如 372 = 37.2C */
    safety_u16 voltage_mv;
    safety_u16 cpu_load_pct;      /* 0..100 */
    safety_u16 fault_count;
};

struct SAFETY_PACKED SafetyFaultEventPayload {
    safety_u8  fault_type;        /* enum safety_fault_type */
    safety_u8  severity;          /* 0=info 1=warn 2=critical */
    safety_u16 detail_code;
    safety_u32 fault_uptime_ms;
};

struct SAFETY_PACKED SafetyCommandPayload {
    safety_u8  command;           /* enum safety_command_type */
    safety_u8  arg8;              /* 例如 INJECT_FAULT 時的 fault_type */
    safety_u16 arg16;             /* 例如 SET_HEARTBEAT_INTERVAL 的 ms */
    safety_u32 arg32;
};

struct SAFETY_PACKED SafetyAckPayload {
    safety_u16 acked_sequence_id;
    safety_u16 reserved;
};

struct SAFETY_PACKED SafetyNackPayload {
    safety_u16 nacked_sequence_id;
    safety_u8  reason;            /* enum safety_nack_reason */
    safety_u8  reserved;
};

struct SAFETY_PACKED SafetyRecoveryReportPayload {
    safety_u8  recovered;         /* 1 = 成功恢復, 0 = 進入 safe mode */
    safety_u8  new_state;         /* co-processor 回報的內部狀態 */
    safety_u16 reserved;
    safety_u32 recovery_uptime_ms;
};

/* ===================================================================
 *  CRC-32 (IEEE 802.3) - 與 zlib / Python binascii.crc32 完全相容
 *  reflected input/output, poly 0xEDB88320, init 0xFFFFFFFF,
 *  final xor 0xFFFFFFFF。三端共用同一份 inline 實作以保證一致。
 * =================================================================== */

/* 不套用 init/final 的單步更新，可跨多段 buffer 累加（與 zlib 連續呼叫等價）。 */
static inline safety_u32 safety_crc32_step(safety_u32 crc,
                                           const void *data, size_t len)
{
    const safety_u8 *p = (const safety_u8 *)data;
    size_t i;
    int k;
    for (i = 0; i < len; i++) {
        crc ^= p[i];
        for (k = 0; k < 8; k++) {
            /* (~(crc & 1u) + 1u) 等於 -(crc & 1u)，避免 signed 溢位 UB */
            crc = (crc >> 1) ^ (0xEDB88320u & (~(crc & 1u) + 1u));
        }
    }
    return crc;
}

/* 單一連續 buffer 的標準 CRC-32。 */
static inline safety_u32 safety_crc32(const void *data, size_t len)
{
    return safety_crc32_step(0xFFFFFFFFu, data, len) ^ 0xFFFFFFFFu;
}

/*
 * 計算 frame checksum：對 (header 之 checksum 欄位歸零後的 16 bytes) 再串接
 * payload 一起做 CRC-32。等價於 Python:
 *   binascii.crc32(header_with_zero_checksum + payload) & 0xFFFFFFFF
 */
static inline safety_u32
safety_frame_compute_checksum(const struct SafetyFrameHeader *hdr,
                              const void *payload, safety_u16 payload_len)
{
    struct SafetyFrameHeader tmp = *hdr;
    safety_u32 crc;
    tmp.checksum = 0;
    crc = safety_crc32_step(0xFFFFFFFFu, &tmp, SAFETY_HEADER_SIZE);
    if (payload && payload_len)
        crc = safety_crc32_step(crc, payload, payload_len);
    return crc ^ 0xFFFFFFFFu;
}

/* ---- Helper：初始化 header（呼叫端後續再填 checksum）---- */
static inline void safety_frame_init(struct SafetyFrameHeader *hdr,
                                     safety_u8 type, safety_u16 sequence_id,
                                     safety_u16 payload_len, safety_u32 ts_ms)
{
    hdr->magic = SAFETY_PROTO_MAGIC;
    hdr->version = SAFETY_PROTO_VERSION;
    hdr->type = type;
    hdr->sequence_id = sequence_id;
    hdr->payload_length = payload_len;
    hdr->timestamp_ms = ts_ms;
    hdr->checksum = 0;
}

/* ---- Helper：填好 payload 後封裝完整 frame，回傳總長度 ---- *
 * out 必須至少 SAFETY_MAX_FRAME_SIZE。失敗 (payload 過長) 回傳 0。      */
static inline size_t safety_frame_pack(safety_u8 *out,
                                       struct SafetyFrameHeader *hdr,
                                       const void *payload)
{
    if (hdr->payload_length > SAFETY_MAX_PAYLOAD)
        return 0;
    hdr->checksum = safety_frame_compute_checksum(hdr, payload,
                                                  hdr->payload_length);
    memcpy(out, hdr, SAFETY_HEADER_SIZE);
    if (payload && hdr->payload_length)
        memcpy(out + SAFETY_HEADER_SIZE, payload, hdr->payload_length);
    return SAFETY_HEADER_SIZE + hdr->payload_length;
}

/* ---- 驗證結果碼 ---- */
enum safety_validate_result {
    SAFETY_VALIDATE_OK            = 0,
    SAFETY_VALIDATE_BAD_MAGIC     = 1,
    SAFETY_VALIDATE_BAD_VERSION   = 2,
    SAFETY_VALIDATE_BAD_LENGTH    = 3,
    SAFETY_VALIDATE_BAD_CHECKSUM  = 4,
};

/*
 * 驗證一段已含完整 header(+payload) 的 buffer。
 * buf_len 是可用位元組數；payload 緊接於 header 之後。
 */
static inline int safety_frame_validate(const safety_u8 *buf, size_t buf_len)
{
    struct SafetyFrameHeader hdr;
    safety_u32 want;
    if (buf_len < SAFETY_HEADER_SIZE)
        return SAFETY_VALIDATE_BAD_LENGTH;
    memcpy(&hdr, buf, SAFETY_HEADER_SIZE);
    if (hdr.magic != SAFETY_PROTO_MAGIC)
        return SAFETY_VALIDATE_BAD_MAGIC;
    if (hdr.version != SAFETY_PROTO_VERSION)
        return SAFETY_VALIDATE_BAD_VERSION;
    if (hdr.payload_length > SAFETY_MAX_PAYLOAD)
        return SAFETY_VALIDATE_BAD_LENGTH;
    if (buf_len < (size_t)SAFETY_HEADER_SIZE + hdr.payload_length)
        return SAFETY_VALIDATE_BAD_LENGTH;
    want = safety_frame_compute_checksum(&hdr, buf + SAFETY_HEADER_SIZE,
                                         hdr.payload_length);
    if (want != hdr.checksum)
        return SAFETY_VALIDATE_BAD_CHECKSUM;
    return SAFETY_VALIDATE_OK;
}

#ifdef __cplusplus
} /* extern "C" */
#endif

#endif /* SAFETY_PROTOCOL_H */
```

## src/command_handler_task.c
```c
/*
 * command_handler_task.c - 命令處理 task
 *
 * 角色：從 g_rx_msgq (由 safety_protocol.c 的 UART RX 狀態機投遞、已驗證
 *       checksum 的 frame) 取出 COMMAND frame，解析 SafetyCommandPayload，
 *       執行對應動作並回 ACK / NACK。
 * CPU pin：無 (scheduler 自由調度)。
 *
 * 支援命令 (enum safety_command_type)：
 *   GET_STATUS             -> 回 TELEMETRY 快照 + ACK
 *   INJECT_FAULT           -> arg8 對應 heartbeat_stop/checksum/critical 旗標 + ACK
 *   REQUEST_RECOVERY       -> 清故障旗標 + 退出 safe mode + RECOVERY_REPORT(1) + ACK
 *   ENTER_SAFE_MODE        -> in_safe_mode=1 + ACK
 *   RESET_FAULT_STATE      -> 清故障旗標 / fault_count / safe mode + ACK
 *
 * 規則：每個被接受的命令都回 ACK (SafetyAckPayload)；
 *       payload 長度不符或未知命令回 NACK (SafetyNackPayload + reason)。
 */

#include <zephyr/kernel.h>

#include "safety_app.h"
#include "safety_protocol.h"

static void send_ack(safety_u16 acked_seq)
{
	struct SafetyAckPayload ack = {
		.acked_sequence_id = acked_seq,
		.reserved = 0,
	};
	(void)safety_send_frame(SAFETY_FRAME_ACK, &ack, sizeof(ack));
}

static void send_nack(safety_u16 nacked_seq, safety_u8 reason)
{
	struct SafetyNackPayload nack = {
		.nacked_sequence_id = nacked_seq,
		.reason = reason,
		.reserved = 0,
	};
	(void)safety_send_frame(SAFETY_FRAME_NACK, &nack, sizeof(nack));
}

/* GET_STATUS：回一個即時 telemetry 快照 (與 telemetry task 同格式)。 */
static void reply_status(void)
{
	struct SafetyTelemetryPayload tm = {
		.temperature_c_x10 = 250,
		.voltage_mv = 3300,
		.cpu_load_pct = 25,
		.fault_count =
			(safety_u16)atomic_get(&g_fault_state.fault_count),
	};
	(void)safety_send_frame(SAFETY_FRAME_TELEMETRY, &tm, sizeof(tm));
}

/* 依 INJECT_FAULT 的 arg8 (= enum safety_fault_type) 設對應旗標。
 * 回傳 true 表示是已知 fault type。 */
static bool apply_inject(safety_u8 fault_type)
{
	switch (fault_type) {
	case SAFETY_FAULT_TASK_HANG:
		atomic_set(&g_fault_state.inject_task_hang, 1);
		return true;
	case SAFETY_FAULT_CHECKSUM_ERROR:
		atomic_set(&g_fault_state.inject_checksum_error, 1);
		return true;
	case SAFETY_FAULT_CRITICAL:
		atomic_set(&g_fault_state.inject_critical_fault, 1);
		return true;
	default:
		return false;
	}
}

/* 清除所有注入旗標 (供 RESET / RECOVERY 共用)。 */
static void clear_all_injects(void)
{
	atomic_clear(&g_fault_state.inject_task_hang);
	atomic_clear(&g_fault_state.inject_checksum_error);
	atomic_clear(&g_fault_state.inject_critical_fault);
}

static void handle_command(const struct safety_rx_frame *frame)
{
	safety_u16 seq = frame->hdr.sequence_id;
	struct SafetyCommandPayload cmd;

	/* payload 長度必須剛好等於 command payload */
	if (frame->hdr.payload_length != sizeof(struct SafetyCommandPayload)) {
		send_nack(seq, SAFETY_NACK_PAYLOAD);
		return;
	}
	memcpy(&cmd, frame->payload, sizeof(cmd));

	switch (cmd.command) {
	case SAFETY_CMD_GET_STATUS:
		reply_status();
		send_ack(seq);
		break;

	case SAFETY_CMD_INJECT_FAULT:
		if (!apply_inject(cmd.arg8)) {
			send_nack(seq, SAFETY_NACK_PAYLOAD);
			break;
		}
		send_ack(seq);
		break;

	case SAFETY_CMD_RESET_FAULT_STATE:
		clear_all_injects();
		atomic_clear(&g_fault_state.fault_count);
		atomic_clear(&g_fault_state.in_safe_mode);
		send_ack(seq);
		break;

	case SAFETY_CMD_ENTER_SAFE_MODE:
		atomic_set(&g_fault_state.in_safe_mode, 1);
		send_ack(seq);
		break;

	case SAFETY_CMD_REQUEST_RECOVERY: {
		/* 清 hang + 退出 safe mode → heartbeat 恢復 kick/送 frame。 */
		clear_all_injects();
		atomic_clear(&g_fault_state.in_safe_mode);

		struct SafetyRecoveryReportPayload rr = {
			.recovered = 1,
			.new_state = 0, /* 0 = normal */
			.reserved = 0,
			.recovery_uptime_ms = safety_now_ms(),
		};
		(void)safety_send_frame(SAFETY_FRAME_RECOVERY_REPORT,
					&rr, sizeof(rr));
		send_ack(seq);
		break;
	}

	default:
		send_nack(seq, SAFETY_NACK_UNKNOWN_TYPE);
		break;
	}
}

void command_handler_task_entry(void *p1, void *p2, void *p3)
{
	ARG_UNUSED(p1);
	ARG_UNUSED(p2);
	ARG_UNUSED(p3);

	struct safety_rx_frame frame;

	while (1) {
		/* 阻塞等待 RX 狀態機投遞的已驗證 frame。 */
		if (k_msgq_get(&g_rx_msgq, &frame, K_FOREVER) != 0) {
			continue;
		}

		/* 此 task 只處理 COMMAND；其它型別非預期 (host->fw 應只送命令)。 */
		if (frame.hdr.type == SAFETY_FRAME_COMMAND) {
			handle_command(&frame);
		} else {
			send_nack(frame.hdr.sequence_id,
				  SAFETY_NACK_UNKNOWN_TYPE);
		}
	}
}
```

## src/fault_monitor_task.c
```c
/*
 * fault_monitor_task.c - 故障監測 task
 *
 * 角色：週期掃描 (100ms) 共享狀態的 inject_* 旗標，對 checksum-error
 *       response 與 critical fault 送 FAULT_EVENT frame，並遞增 fault_count。
 * CPU pin：無 (由 scheduler 自由調度於 CPU0/CPU1)。
 *
 * 設計：以 edge-triggered (邊緣觸發) 為主——旗標由 0→1 才送 event，
 *       避免每次掃描都重複送同一個 fault。heartbeat_stop 不在此送 fault；
 *       它由 heartbeat task 停送 HEARTBEAT，讓 Linux 端 timeout 偵測。
 */

#include <zephyr/kernel.h>
#include "safety_app.h"
#include "safety_protocol.h"

/* severity 對應 safety_protocol.h 註解：0=info 1=warn 2=critical */
#define SEV_INFO      0
#define SEV_WARN      1
#define SEV_CRITICAL  2

static void emit_fault(safety_u8 fault_type, safety_u8 severity,
		       safety_u16 detail_code)
{
	struct SafetyFaultEventPayload ev = {
		.fault_type = fault_type,
		.severity = severity,
		.detail_code = detail_code,
		.fault_uptime_ms = safety_now_ms(),
	};

	atomic_inc(&g_fault_state.fault_count);
	(void)safety_send_frame(SAFETY_FRAME_FAULT_EVENT, &ev, sizeof(ev));
}

void fault_monitor_task_entry(void *p1, void *p2, void *p3)
{
	ARG_UNUSED(p1);
	ARG_UNUSED(p2);
	ARG_UNUSED(p3);

	/* 上一輪各旗標狀態，用於偵測 0→1 邊緣 */
	bool prev_checksum = false;
	bool prev_critical = false;

	while (1) {
		bool checksum =
			atomic_get(&g_fault_state.inject_checksum_error) != 0;
		bool critical =
			atomic_get(&g_fault_state.inject_critical_fault) != 0;

		/* --- CHECKSUM_ERROR：邊緣觸發，warn --- */
		if (checksum && !prev_checksum) {
			emit_fault(SAFETY_FAULT_CHECKSUM_ERROR, SEV_WARN, 0x0002);
		}

		/* --- CRITICAL_FAULT：邊緣觸發，critical --- */
		if (critical && !prev_critical) {
			emit_fault(SAFETY_FAULT_CRITICAL, SEV_CRITICAL, 0x0003);
			atomic_set(&g_fault_state.in_safe_mode, 1);
		}

		prev_checksum = checksum;
		prev_critical = critical;

		k_msleep(SAFETY_FAULT_SCAN_MS);
	}
}
```

## src/heartbeat_task.c
```c
/*
 * heartbeat_task.c - 心跳 task
 *
 * 角色：每 heartbeat_interval_ms (預設 100ms) 送一個 HEARTBEAT frame，
 *       讓 host 端判斷 co-processor 是否存活。
 * CPU pin：CPU0 (見 main.c)。心跳是最關鍵的存活訊號，刻意與 CPU1 上可能
 *          爆量的 telemetry 隔離，確保心跳節奏不被遙測負載拖累。
 *
 * 故障模擬：
 *   - inject_task_hang：heartbeat_stop，停止送 HEARTBEAT frame。
 *   - in_safe_mode：safe mode 下停送週期性心跳 (符合「安全停機」語意)。
 */

#include <zephyr/kernel.h>
#include "safety_app.h"
#include "safety_protocol.h"

void heartbeat_task_entry(void *p1, void *p2, void *p3)
{
	ARG_UNUSED(p1);
	ARG_UNUSED(p2);
	ARG_UNUSED(p3);

	uint32_t beat_seq = 0;

	while (1) {
		uint32_t interval =
			(uint32_t)atomic_get(&g_fault_state.heartbeat_interval_ms);

		/* 防呆：避免 0ms 造成忙迴圈 */
		if (interval == 0) {
			interval = SAFETY_DEFAULT_HEARTBEAT_MS;
		}

		bool hang = atomic_get(&g_fault_state.inject_task_hang) != 0;
		bool safe = atomic_get(&g_fault_state.in_safe_mode) != 0;

		if (!hang && !safe) {
			struct SafetyHeartbeatPayload hb = {
				.uptime_ms = safety_now_ms(),
				.beat_seq = beat_seq++,
			};
			(void)safety_send_frame(SAFETY_FRAME_HEARTBEAT,
						&hb, sizeof(hb));
		}

		k_msleep(interval);
	}
}
```

## src/safety_protocol.c
```c
/*
 * safety_protocol.c - firmware 端通訊協定 IO 輔助
 *
 * 角色 (非 task，無 CPU pin；在呼叫者的 context 與 UART ISR context 執行)：
 *   1. 時間源：safety_now_ms() 以 k_uptime_get() 提供單調毫秒。
 *   2. UART：取得裝置、安裝 interrupt-driven callback、RX 中斷收位元組。
 *   3. RX frame 組裝狀態機：在 ISR 內把原始位元組 hunt magic → 讀 header →
 *      讀 payload_length bytes → safety_frame_validate() → 丟進 g_rx_msgq。
 *   4. TX：safety_send_frame() 用 safety_frame_pack() 封包，整包以 polling
 *      uart_poll_out 送出 (受 mutex 保護，避免多 task 交錯)。
 *
 * UART 選擇：使用 board 的 console UART = DT_CHOSEN(zephyr_console)。
 *   在 qemu_cortex_a53 上即 PL011。FORMAL build 關閉 shell，故 console UART
 *   專供二進位協定使用，不會被 shell 文字污染。DEBUG build 開 shell 時兩者
 *   共用同一條 UART（僅供人工注入故障，不跑正式 host 協定）。
 *
 * 設計取捨：
 *   - RX 走 interrupt-driven (CONFIG_UART_INTERRUPT_DRIVEN)：低延遲收命令。
 *   - TX 走 polling uart_poll_out：frame 很短 (<= 32 bytes)，實作簡單且
 *     不需 TX FIFO 中斷狀態機；以 mutex 保證整包原子送出。
 */

#include <zephyr/kernel.h>
#include <zephyr/device.h>
#include <zephyr/drivers/uart.h>

#include "safety_app.h"
#include "safety_protocol.h"

/* console UART = 二進位協定通道 (見檔頭說明) */
static const struct device *const uart_dev =
	DEVICE_DT_GET(DT_CHOSEN(zephyr_console));

/* ===================================================================
 *  時間源
 * =================================================================== */
uint32_t safety_now_ms(void)
{
	/* k_uptime_get() 回傳 int64_t ms，截成 32-bit 給線格式 (約 49.7 天回繞)。 */
	return (uint32_t)k_uptime_get();
}

/* ===================================================================
 *  TX
 * =================================================================== */
static K_MUTEX_DEFINE(tx_mutex);          /* 保護整包送出不交錯 */
static atomic_t tx_sequence = ATOMIC_INIT(0);

uint32_t safety_tx_seq_peek(void)
{
	return (uint32_t)atomic_get(&tx_sequence);
}

int safety_send_frame(safety_u8 type, const void *payload,
		      safety_u16 payload_len)
{
	static safety_u8 frame_buf[SAFETY_MAX_FRAME_SIZE]; /* 受 tx_mutex 保護 */
	struct SafetyFrameHeader hdr;
	size_t total;
	safety_u16 seq;

	if (payload_len > SAFETY_MAX_PAYLOAD) {
		return -EINVAL;
	}
	if (!device_is_ready(uart_dev)) {
		return -ENODEV;
	}

	/* sequence_id 單調遞增 (atomic_inc 回傳舊值)。 */
	seq = (safety_u16)atomic_inc(&tx_sequence);

	safety_frame_init(&hdr, type, seq, payload_len, safety_now_ms());

	k_mutex_lock(&tx_mutex, K_FOREVER);

	total = safety_frame_pack(frame_buf, &hdr, payload);
	if (total == 0) {
		k_mutex_unlock(&tx_mutex);
		return -EINVAL;
	}

	/* 整包逐 byte polling 送出；frame 很短，無阻塞顧慮。 */
	for (size_t i = 0; i < total; i++) {
		uart_poll_out(uart_dev, frame_buf[i]);
	}

	k_mutex_unlock(&tx_mutex);
	return (int)total;
}

/* ===================================================================
 *  RX：interrupt-driven + frame 組裝狀態機
 * =================================================================== */

/* 解析完成的 frame 投遞佇列：最多 8 筆待處理命令。 */
K_MSGQ_DEFINE(g_rx_msgq, sizeof(struct safety_rx_frame), 8, 4);

/* RX 狀態機階段 */
enum rx_phase {
	RX_HUNT_MAGIC_LO,   /* 找 magic 低位元組 (0x46 = 'F') */
	RX_HUNT_MAGIC_HI,   /* 找 magic 高位元組 (0x53 = 'S') */
	RX_HEADER,          /* 收剩餘 header bytes */
	RX_PAYLOAD,         /* 收 payload bytes */
};

struct rx_state {
	enum rx_phase phase;
	safety_u8 buf[SAFETY_MAX_FRAME_SIZE]; /* header + payload 暫存 */
	size_t need;        /* 當前階段還需幾個 byte */
	size_t got;         /* buf 內已累積 byte 數 */
	safety_u16 payload_len;
};

static struct rx_state rxs = {
	.phase = RX_HUNT_MAGIC_LO,
};

/* SAFETY_PROTO_MAGIC = 0x5346，little-endian 線上順序：先 0x46 再 0x53。 */
#define MAGIC_LO ((safety_u8)(SAFETY_PROTO_MAGIC & 0xFFu))        /* 0x46 'F' */
#define MAGIC_HI ((safety_u8)((SAFETY_PROTO_MAGIC >> 8) & 0xFFu)) /* 0x53 'S' */

static void rx_reset(void)
{
	rxs.phase = RX_HUNT_MAGIC_LO;
	rxs.need = 0;
	rxs.got = 0;
	rxs.payload_len = 0;
}

/* 在 ISR context 餵入單一 byte 推進狀態機。 */
static void rx_feed_byte(safety_u8 b)
{
	switch (rxs.phase) {
	case RX_HUNT_MAGIC_LO:
		if (b == MAGIC_LO) {
			rxs.buf[0] = b;
			rxs.got = 1;
			rxs.phase = RX_HUNT_MAGIC_HI;
		}
		/* 否則持續 hunt，丟棄雜訊 byte */
		break;

	case RX_HUNT_MAGIC_HI:
		if (b == MAGIC_HI) {
			rxs.buf[1] = b;
			rxs.got = 2;
			/* 已收到 magic 兩 byte，接著收剩餘 header */
			rxs.need = SAFETY_HEADER_SIZE - 2u;
			rxs.phase = RX_HEADER;
		} else if (b == MAGIC_LO) {
			/* 連續兩個 lo：把這個當新的 lo，停在 HI 階段 */
			rxs.buf[0] = b;
			rxs.got = 1;
		} else {
			rx_reset();
		}
		break;

	case RX_HEADER:
		rxs.buf[rxs.got++] = b;
		rxs.need--;
		if (rxs.need == 0) {
			/* header 收齊：取出 payload_length (offset 6, little-endian) */
			struct SafetyFrameHeader hdr;

			memcpy(&hdr, rxs.buf, SAFETY_HEADER_SIZE);
			if (hdr.payload_length > SAFETY_MAX_PAYLOAD) {
				/* 長度非法：丟棄並重新 hunt */
				rx_reset();
				break;
			}
			rxs.payload_len = hdr.payload_length;
			if (rxs.payload_len == 0) {
				goto frame_complete;
			}
			rxs.need = rxs.payload_len;
			rxs.phase = RX_PAYLOAD;
		}
		break;

	case RX_PAYLOAD:
		rxs.buf[rxs.got++] = b;
		rxs.need--;
		if (rxs.need == 0) {
			goto frame_complete;
		}
		break;
	}
	return;

frame_complete:
	/* 完整 frame 已在 rxs.buf；驗證 checksum 後投遞。 */
	if (safety_frame_validate(rxs.buf, rxs.got) == SAFETY_VALIDATE_OK) {
		struct safety_rx_frame msg;

		memcpy(&msg.hdr, rxs.buf, SAFETY_HEADER_SIZE);
		if (rxs.payload_len) {
			memcpy(msg.payload, rxs.buf + SAFETY_HEADER_SIZE,
			       rxs.payload_len);
		}
		/* ISR context：用 K_NO_WAIT；佇列滿則丟棄 (host 會重送/逾時)。 */
		(void)k_msgq_put(&g_rx_msgq, &msg, K_NO_WAIT);
	}
	/* checksum 失敗：靜默丟棄，host 端會自行偵測逾時/重送。 */
	rx_reset();
}

/* UART interrupt callback：把 RX FIFO 內的 byte 全部餵進狀態機。
 * 採 Zephyr 標準範式：update -> is_pending -> rx_ready -> fifo_read。
 * 只啟用 RX 中斷 (未啟用 TX IRQ)，故只處理 RX；無 RX 待處理即離開，
 * 避免因其它 pending 旗標造成忙迴圈。 */
static void uart_isr(const struct device *dev, void *user_data)
{
	ARG_UNUSED(user_data);

	while (uart_irq_update(dev) > 0) {
		if (uart_irq_is_pending(dev) <= 0) {
			break;
		}
		if (uart_irq_rx_ready(dev)) {
			safety_u8 byte;

			while (uart_fifo_read(dev, &byte, 1) == 1) {
				rx_feed_byte(byte);
			}
		} else {
			/* pending 但非 RX (例如 TX，本專案未用)：消耗後離開。 */
			break;
		}
	}
}

int safety_uart_init(void)
{
	int ret;

	if (!device_is_ready(uart_dev)) {
		return -ENODEV;
	}

	rx_reset();

	ret = uart_irq_callback_set(uart_dev, uart_isr);
	if (ret < 0 && ret != -ENOSYS && ret != -ENOTSUP) {
		return ret;
	}

	uart_irq_rx_enable(uart_dev);
	return 0;
}
```

## src/telemetry_task.c
```c
/*
 * telemetry_task.c - 遙測 task
 *
 * 角色：週期性 (預設 250ms) 送 TELEMETRY frame，回報模擬感測值：
 *       temperature_c_x10 / voltage_mv / cpu_load_pct / fault_count。
 * CPU pin：CPU1 (見 main.c)。遙測與心跳分屬不同 CPU，避免一般 telemetry
 *          工作影響 heartbeat 節奏。safe mode 下停送週期性遙測。
 */

#include <zephyr/kernel.h>
#include "safety_app.h"
#include "safety_protocol.h"

/* 模擬感測值：以簡單可預測的方式變動，方便 host 端比對 */
#define TEMP_BASE_X10     250   /* 25.0C 起跳 */
#define TEMP_SWING_X10    150   /* 上下擺動幅度 */
#define VOLTAGE_NOMINAL   3300  /* 3.300 V */

void telemetry_task_entry(void *p1, void *p2, void *p3)
{
	ARG_UNUSED(p1);
	ARG_UNUSED(p2);
	ARG_UNUSED(p3);

	uint32_t tick = 0;

	while (1) {
		bool safe = atomic_get(&g_fault_state.in_safe_mode) != 0;

		if (!safe) {
			struct SafetyTelemetryPayload tm;

			/* 用三角波模擬溫度緩慢擺動 (確定性，host 易驗證) */
			uint32_t phase = tick % 20;
			int32_t delta = (phase < 10)
				? (int32_t)(phase * (TEMP_SWING_X10 / 10))
				: (int32_t)((20 - phase) *
					    (TEMP_SWING_X10 / 10));
			tm.temperature_c_x10 =
				(safety_u16)(TEMP_BASE_X10 + delta);

			tm.voltage_mv = VOLTAGE_NOMINAL;
			tm.cpu_load_pct = (safety_u16)(20 + (tick % 30));
			tm.fault_count =
				(safety_u16)atomic_get(&g_fault_state.fault_count);

			(void)safety_send_frame(SAFETY_FRAME_TELEMETRY,
						&tm, sizeof(tm));
		}

		tick++;

		k_msleep(SAFETY_TELEMETRY_PERIOD_MS);
	}
}
```
